## meta-clanton-bsp/conf/machine/clanton.conf
```bitbake
#@TYPE: Machine
#@NAME: clanton

#@DESCRIPTION: Machine configuration for clanton systems

PREFERRED_PROVIDER_virtual/kernel ?= "linux-yocto-clanton"
PREFERRED_VERSION_linux-yocto-clanton ?= "3.8%"

require conf/machine/include/ia32-base.inc
include conf/machine/include/tune-i586.inc

#Avoid pulling in GRUB
MACHINE_ESSENTIAL_EXTRA_RDEPENDS = ""

MACHINE_FEATURES = "efi usb pci"

SERIAL_CONSOLE = "115200 ttyS1"
#SERIAL_CONSOLES = "115200;ttyS0 115200;ttyS1"

EXTRA_IMAGEDEPENDS = "grub"
PREFERRED_VERSION_grub = "0.97+git%"

module_autoload_ad7298 = "ad7298"
module_autoload_spidev = "spidev"
module_autoload_hcd = "ehci_hcd ohci_hcd ehci-pci"
module_autoload_usb_storage = "usb_storage"
module_autoload_cy8c9540a = "pch-udc g_serial gpio_sch intel_cln_gip cy8c9540a"
module_conf_g_serial = "options g_serial vendor=0x8086 product=0xBABE"
module_conf_intel_cln_gip = "options intel_cln_gip i2c_std_mode=1"
module_autoload_at24 = "at24"
module_autoload_i2c_dev = "i2c_dev"
module_autoload_spidev = "spidev"
module_autoload_mtd = "mtd"
module_autoload_spi-pxa2xx = "spi-pxa2xx"
module_autoload_spi-pxa2xx-pci = "spi-pxa2xx-pci"
module_autoload_m25p80 = "m25p80"
module_autoload_usbhid = "usbhid"
```

## meta-clanton-distro/conf/bblayers.conf.sample
```bitbake
# LAYER_CONF_VERSION is increased each time build/conf/bblayers.conf
# changes incompatibly
LCONF_VERSION = "6"

BBPATH = "${TOPDIR}"
BBFILES ?= ""

BBLAYERS ?= " \
  ##OEROOT##/meta \
  ##OEROOT##/meta-oe \
  ##OEROOT##/meta-clanton-distro \
  ##OEROOT##/meta-yocto \
  ##OEROOT##/meta-intel \
  ##OEROOT##/meta-clanton-bsp \
  ##OEROOT##/meta-clanton-galileo \
  "
BBLAYERS_NON_REMOVABLE ?= " \
  ##OEROOT##/meta \
  ##OEROOT##/meta-yocto \
  "
```

## meta-clanton-galileo/conf/layer.conf
```bitbake
# We have a conf and classes directory, add to BBPATH
BBPATH := "${BBPATH}:${LAYERDIR}"

# We have a recipes directory, add to BBFILES
BBFILES := "${BBFILES} ${LAYERDIR}/recipes-*/*/*.bb \
	${LAYERDIR}/recipes-*/*/*.bbappend"

BBFILE_COLLECTIONS += "clanton-galileo"
BBFILE_PATTERN_clanton-galileo := "^${LAYERDIR}/"
BBFILE_PRIORITY_clanton-galileo = "9"
```

## meta-iot-devkit/conf/bblayers.conf.sample
```bitbake
# LAYER_CONF_VERSION is increased each time build/conf/bblayers.conf
# changes incompatibly
LCONF_VERSION = "6"

BBPATH = "${TOPDIR}"
BBFILES ?= ""

BBLAYERS ?= " \
  ##OEROOT##/meta \
  ##OEROOT##/meta-oe \
  ##OEROOT##/meta-iot-devkit \
  ##OEROOT##/meta-yocto \
  ##OEROOT##/meta-intel \
  ##OEROOT##/meta-clanton-bsp \
  ##OEROOT##/meta-galileo \
  "
BBLAYERS_NON_REMOVABLE ?= " \
  ##OEROOT##/meta \
  ##OEROOT##/meta-yocto \
  "
```

## meta-iot-devkit/conf/distro/include/iot-devkit.inc
```bitbake
SANITY_TESTED_DISTROS = " \
            Poky-1.5 \n \
            Ubuntu-12.04 \n \
            Ubuntu-13.10 \n \
            Fedora-19 \n \
            Debian-7.0 \n \
            Debian-7.1 \n \
            Debian-7.2 \n \
            Debian-7.3 \n \
            openSUSE-project-12.3 \n \
            "

DISTRO_VERSION = "1.0"
DISTRO_CODENAME = "monkey"
DISTRO_NAME = "iot-devkit (Intel IoT Development Kit)"
MAINTAINER = "Yocto Devkit <yocto-devkit@linux.intel.com>"

TARGET_VENDOR = "-iotkit"
SDK_VENDOR = "-iotkit"

SSTATE_DIR = "${TOPDIR}/../devkit-cache/sstate-cache"
CACHE_forcevariable = "${TOPDIR}/../devkit-cache/cache"
PERSISTENT_DIR = "${TOPDIR}/../devkit-cache/persistent"
```

## meta-iot-devkit/conf/distro/iot-devkit.conf
```bitbake
require conf/distro/poky.conf
require include/iot-devkit.inc

DISTRO = "iot-devkit"

PREFERRED_PROVIDER_virtual/kernel = "linux-yocto-clanton"
PREFERRED_VERSION_ethtool = "3.6%"
PREFERRED_VERSION_linux-yocto-clanton = "3.8%"
#PREFERRED_VERSION_grub = "0.97%"

# change these to something better
IMAGE_FSTYPES = "cpio.gz cpio.lzma"

PACKAGE_CLASSES = "package_ipk"

VIRTUAL-RUNTIME_dev_manager = ""
VIRTUAL-RUNTIME_init_manager = "sysvinit"
VIRTUAL-RUNTIME_initscripts = "initscripts"
```

## scripts/lib/image/canned-wks/iot-devkit.wks
```
# short-description: Create the iot-devkit disk image
# long-description: Creates the partitioned disk image that the user
# can directly dd to the sdcard.

part /boot --source iot-devkit --size 50 --ondisk mmcblkp0 --fstype=msdos --label msdos --active --align 1024

# this assumes that your SD card is 7.05GB+
part / --source rootfs --size 7000 --ondisk mmcblkp0 --fstype=ext3 --label platform --align 1024
```
